/dts-v1/;
/plugin/;

/ {
    compatible = "brcm,bcm2835", "brcm,bcm2708";

    fragment@0 {
        target = <&soc>;
        __overlay__ {
            #address-cells = <1>;
            #size-cells = <1>;
            simtemp0: simtemp@0 {
                compatible = "nxp,simtemp";
                reg = <0x0 0x0>;
                sampling-ms = <250>;
                threshold-mC = <45000>;
                status = "okay";
            };
        };
    };
};
